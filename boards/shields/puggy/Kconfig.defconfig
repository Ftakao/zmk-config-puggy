## boards/shields/puggy/Kconfig.defconfig
```kconfig
if SHIELD_PUGGY_LEFT

config ZMK_KEYBOARD_NAME
    default "puggy"

config ZMK_SPLIT_ROLE_CENTRAL
    default y

endif # SHIELD_PUGGY_LEFT

if SHIELD_PUGGY_LEFT || SHIELD_PUGGY_RIGHT

config ZMK_SPLIT
    default y

endif # SHIELD_PUGGY_LEFT || SHIELD_PUGGY_RIGHT
```

## boards/shields/puggy/Kconfig.shield
```kconfig
config SHIELD_PUGGY_LEFT
    def_bool $(shields_list_contains,puggy_left)

config SHIELD_PUGGY_RIGHT
    def_bool $(shields_list_contains,puggy_right)
```
